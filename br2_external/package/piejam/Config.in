## br2_external/package/piejam/Config.in
```kconfig
config BR2_PACKAGE_PIEJAM
	bool "piejam"
	default y
	depends on BR2_INSTALL_LIBSTDCPP
	select BR2_PACKAGE_FMT
	select BR2_PACKAGE_BOOST
	select BR2_PACKAGE_DEJAVU
	select BR2_PACKAGE_QT5
	select BR2_PACKAGE_QT5BASE_GUI
	select BR2_PACKAGE_QT5BASE_EGLFS
	select BR2_PACKAGE_QT5BASE_FONTCONFIG
	select BR2_PACKAGE_QT5BASE_PNG
	select BR2_PACKAGE_QT5GRAPHICALEFFECTS
	select BR2_PACKAGE_QT5QUICKCONTROLS2
	select BR2_PACKAGE_QT5VIRTUALKEYBOARD
	select BR2_PACKAGE_JSON_FOR_MODERN_CPP
	select BR2_PACKAGE_LADSPA
	select BR2_PACKAGE_SPDLOG
	select BR2_PACKAGE_FFTW
	select BR2_PACKAGE_FFTW_SINGLE
	select BR2_PACKAGE_LIBSNDFILE
	select BR2_PACKAGE_JACK2
	select BR2_PACKAGE_ALSA_LIB
	select BR2_PACKAGE_ALSA_LIB_MIXER
	select BR2_PACKAGE_ALSA_LIB_PCM
	select BR2_PACKAGE_ALSA_LIB_RAWMIDI
	select BR2_PACKAGE_ALSA_LIB_SEQ
	select BR2_PACKAGE_RTAUDIO
	select BR2_PACKAGE_RTMIDI
	select BR2_PACKAGE_PORTAUDIO
	select BR2_PACKAGE_PORTMIDI
	select BR2_PACKAGE_LIBLO
	help
	  PieJam's main application

comment "piejam needs a toolchain w/ C++"
	depends on !BR2_INSTALL_LIBSTDCPP


if BR2_PACKAGE_PIEJAM

config BR2_PACKAGE_PIEJAM_BENCHMARKS
	bool "install PieJam benchmarks"
	default n
	select BR2_PACKAGE_BENCHMARK
	help
	  Build and install Piejam benchmarks

config BR2_PACKAGE_PIEJAM_TEST_APPS
	bool "install PieJam test apps"
	default n
	help
	  Build and install Piejam test apps

config BR2_PACKAGE_PIEJAM_TESTS
	bool "install PieJam tests"
	default n
	select BR2_PACKAGE_GTEST
	select BR2_PACKAGE_GTEST_GMOCK
	help
	  Build and install Piejam tests

endif
```
